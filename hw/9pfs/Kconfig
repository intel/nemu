## hw/9pfs/Kconfig
```kconfig
config VIRTIO_9P
    bool
    default y if !VIRT
    depends on VIRTFS && VIRTIO
```

## hw/core/Kconfig
```kconfig
config EMPTY_SLOT
    bool

config PTIMER
    bool

config FITLOADER
    bool

config GPIO_IRQ
    bool

config PLATFORM_BUS
    bool
```

## hw/cpu/Kconfig
```kconfig
config ARM11MPCORE
    bool

config A9MPCORE
    bool

config A15MPCORE
    bool

config CPU_DEVICE
    bool

config CPU_CLUSTER
    bool
```

## hw/input/Kconfig
```kconfig
config ADB
    bool

config HID_DEV
    bool

config LM832X
    bool
    depends on I2C

config PCKBD
    bool
    default y
    depends on ISA_BUS

config PL050
    bool

config PS2_DEV
    bool

config STELLARIS_INPUT
    bool

config TSC2005
    bool

config VIRTIO_INPUT
    bool
    default y if !VIRT
    depends on VIRTIO

config VIRTIO_INPUT_HOST
    bool
    default y if !VIRT
    depends on VIRTIO && LINUX

config TSC210X
    bool
```

## hw/nvram/Kconfig
```kconfig
config DS1225Y
    bool

config AT24C
    bool
    depends on I2C

config CHRP_NVRAM
    bool

config MAC_NVRAM
    bool
    select CHRP_NVRAM
```

## hw/pci/Kconfig
```kconfig
config PCI_SHPC
    bool
    depends on PCI

config PCI
    bool

config PCI_EXPRESS
    bool
    select PCI

config PCI_DEVICES
    bool

config MSI_NONBROKEN
    # selected by interrupt controllers that do not support MSI,
    # or support it and have a good implementation. See commit
    # 47d2b0f33c664533b8dbd5cb17faa8e6a01afe1f.
    bool
```

## hw/usb/Kconfig
```kconfig
config USB_CORE
    bool
    default y
    depends on USB_REDIR

config USB
    bool
    default y if USB_CORE
    select HID_DEV

config USB_UHCI
    bool
    default y if PCI_DEVICES && USB_CORE
    depends on PCI
    select USB

config USB_OHCI
    bool
    default y if PCI_DEVICES && USB_CORE
    depends on PCI
    select USB

config USB_EHCI
    bool
    default y if PCI_DEVICES && USB_CORE
    depends on PCI
    select USB

config USB_EHCI_SYSBUS
    bool
    select USB

config USB_XHCI
    bool
    default y if PCI_DEVICES && USB_CORE
    depends on PCI
    select USB

config USB_XHCI_NEC
    bool
    default y if PCI_DEVICES && USB_CORE
    depends on PCI
    select USB

config USB_MUSB
    bool
    select USB

config TUSB6010
    bool
    select USB_MUSB

config USB_TABLET_WACOM
    bool
    default y if USB_CORE
    depends on USB

config USB_STORAGE_BOT
    bool
    default y if USB_CORE
    depends on USB
    select SCSI

config USB_STORAGE_UAS
    bool
    default y if USB_CORE
    depends on USB
    select SCSI

config USB_AUDIO
    bool
    default y if USB_CORE
    depends on USB

config USB_SERIAL
    bool
    default y if USB_CORE
    depends on USB

config USB_NETWORK
    bool
    default y if USB_CORE
    depends on USB

config USB_BLUETOOTH
    bool
    default y if USB_CORE
    depends on USB

config USB_SMARTCARD
    bool
    default y if USB_CORE
    depends on USB

config USB_STORAGE_MTP
    bool
    default y if USB_CORE
    depends on USB
```

## hw/vfio/quirks/Kconfig
```kconfig
config VFIO_PCI_QUIRKS_IGD
    bool
    depends on PCI

config VFIO_PCI_QUIRKS_ATI
    bool
    depends on PCI
```
